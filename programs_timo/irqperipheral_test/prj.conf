## prj.conf
```kconfig
# WARNING: check that no unecessary spaces before/after values!
# WARNING: not tested
CONFIG_NUM_IRQS=65
CONFIG_SYS_LOG=y
```

## src/main.c
```c
#include <zephyr.h>
#include <misc/printk.h>
#include <device.h>

#include "irqtestperipheral.h"
#include "tests/test_runners.h"
#include "tests/tests.h"
#include "cycles.h"
#include "log_perf.h"

#include "state_manager.h"
#ifndef TEST_MINIMAL
#include <string.h>
#endif
#include "state_machines/sm1.h"

#define IRQTESTER_DRV_NAME "irqtester0"
#define IRQTESTER_HW_REV 3


int global_max_cyc;


// copy of disabled function in devices.c
extern struct device __device_init_end[];
extern struct device __device_init_start[];
void device_list_get(struct device **device_list, int *device_count)
{

	*device_list = __device_init_start;
	*device_count = __device_init_end - __device_init_start;
}

// attention: uses "heavy" strcmp
void print_device_drivers(){
	#ifndef TEST_MINIMAL
	struct device *dev_list_buf;
	int len;

	device_list_get(&dev_list_buf, &len);

	printk("Found %i device drivers: \n", len);
	for(int i=0; i<len; i++){
		char * name = dev_list_buf[i].config->name;
		printk("%s @ %p, ", (strcmp("", name) == 0 ? "<unnamed>" : name), dev_list_buf[i].config->config_info);
	}
	printk("\n");
	#endif
}

// make static to keep handle after main thread is done
static struct device *dev;

void print_kernel_info(){

	#ifndef CONFIG_PREEMPT_ENABLED
	#define PRINT_CONFIG_PREEMPT_ENABLED 0
	#else
	#define PRINT_CONFIG_PREEMPT_ENABLED CONFIG_PREEMPT_ENABLED
	#endif
	#ifndef CONFIG_TIMESLICING
	#define PRINT_CONFIG_TIMESLICING 0
	#else
	#define PRINT_CONFIG_TIMESLICING CONFIG_TIMESLICING
	#endif
	#ifndef CONFIG_IRQ_OFFLOAD
	#define PRINT_CONFIG_IRQ_OFFLOAD 0
	#else
	#define PRINT_CONFIG_IRQ_OFFLOAD CONFIG_IRQ_OFFLOAD
	#endif
	u32_t t_rtc = k_cycle_get_32();
	u32_t t_cyc = get_cycle_32();
	printk("Boot finished at rtc / cycles: [%u / %u] \n", t_rtc, t_cyc);
	printk("Kernel Config Info:" \
		"\nMain thread @%p prio: %i \nTimeslicing: %i \nPreempt: %i \nIRQ_offloading: %i\n" \
		"isr.S optimization: %i\n",
		k_current_get(), CONFIG_MAIN_THREAD_PRIORITY, PRINT_CONFIG_TIMESLICING,
		PRINT_CONFIG_PREEMPT_ENABLED, PRINT_CONFIG_IRQ_OFFLOAD, CONFIG_FE310_ISR_PLIC_OPT_LVL);
}


void main(void)
{	
	print_kernel_info();
	print_device_drivers();
	printk("Starting irqtester test for hw rev. %i on arch: %s\n", IRQTESTER_HW_REV, CONFIG_ARCH);

	// get driver handles
	dev = device_get_binding(IRQTESTER_DRV_NAME);

	if (!dev) {
		printk("Cannot find %s!\n", IRQTESTER_DRV_NAME);
		return;
	}

	irqtester_fe310_enable(dev);
	
	//test_uint_overflow();
	print_set_verbosity(1);

	run_test_hw_basic_1(dev);	// sets printkv verbosity to 1



	//run_test_timing_rx(dev);

	// test basic functionality

	//run_test_irq_throughput_1(dev);
	//run_test_irq_throughput_2(dev);

	//run_test_irq_throughput_3_autoadj(dev 1);
	//run_test_irq_throughput_3_autoadj(dev, 2);
	//PRINT_LOG_BUFF();

	//run_test_poll_throughput_1_autoadj(dev);
	
	run_test_state_mng_1(dev);
	//run_test_sm1_throughput_1(dev);
	//PRINT_LOG_BUFF();
	//run_test_sm_throughput_2(dev, 1);
	//run_test_sm_throughput_2(dev, 2);
	run_test_sm2_action_perf_3(dev);
	//run_test_sm2_action_prof_4(dev);
	PRINT_LOG_BUFF();
	

	int i=0;
	bool abort = true;
	do{
		i++;
		printk("Entering cycle %i. Global max %i \n", i, global_max_cyc);

		
		// timing
		//run_test_timing_rx(dev);
		//run_test_min_timing_rx(dev);
		//run_test_state_mng_1(dev);

	}while(!abort);
	

	printk("Total uptime / init time  %u ms \n", k_uptime_get_32());
	printk("***** Main thread: I'm done here... Goodbye! ***** \n");
	while(1){
		k_yield();
		// for some reason crashes when exiting main thread, must define threads in main?
	}
	return; // end main thread
}
```

## src/cycles.c
```c
#include "cycles.h"
#include <stdio.h>
#include "encoding.h"

#define CYCLES_CPUCYC_PER_US 65 // todo: derive from CONFIG_ macro

// from sifive-freedom-sdk
// The mcycle counter is 64-bit counter, but since
// Freedom E platforms use RV32, we must access it as
// 2 32-bit registers. At 256MHz, the lower bits will
// roll over approx. every 5 seconds, so we check for
// rollover with this routine as suggested by the
// RISC-V Priviledged Architecture Specification.

#define rdmcycle(x)({				       \
    uint32_t lo, hi, hi2;			       \
    __asm__ __volatile__ ("1:\n\t"		       \
			  "csrr %0, mcycleh\n\t"       \
			  "csrr %1, mcycle\n\t"	       \
			  "csrr %2, mcycleh\n\t"       \
			  "bne  %0, %2, 1b\n\t"			\
			  : "=r" (hi), "=r" (lo), "=r" (hi2)) ;	\
    *(x) = lo | ((uint64_t) hi << 32); 				\
})


/// read lower 32 bits of cycle csr register
u32_t get_cycle_32(){
    u32_t cycle;
    return rdmcycle(&cycle);
}
    

/**
 * @brief Wait for at least t_cyc cpu cycles.
 * 
 * No upper limit of waiting time guaranteed!
 * Busy waiting currently, since no hw timers implemented yet.
 */ 
void cycle_busy_wait(u32_t t_cyc){
    
    u32_t start = get_cycle_32();
    u32_t now = start;

     while(t_cyc > (now - start)){
        now = get_cycle_32();
    }

}

u32_t cycle_us_2_cyc(u32_t t_us){
    return CYCLES_CPUCYC_PER_US * t_us;
}

/// Attention: result is rounded
u32_t cycle_cyc_2_us(u32_t t_cyc){
    return t_cyc / CYCLES_CPUCYC_PER_US;
}
```

## src/cycles.h
```c
/**
 * @file
 * @brief  Read riscv32 hardware cpu cycle count (not realtime counter (rtc))
 */



#ifndef CYCLES_H
#define CYCLES_H

#include <zephyr.h>

u32_t get_cycle_32();
void cycle_busy_wait(u32_t t_cyc);

#endif
```

## src/irqtestperipheral.h
```c
/**
 * @file
 * @brief low-level driver functions to interact with hardware
 */


#ifndef IRQTESTPERIPHERAL_H
#define IRQTESTPERIPHERAL_H

#include <device.h>

// ugly global, get rid of by cleaning up driver API
extern struct device * g_dev_cp;

// todo: 
// - refine naming convention for all global namespace items
//   st. values and functions visibale to the outside
//   are unique in namespace and share leading identifier eg. IRQT_tet
// - introduce irq ids


/** List all available values with naming convention
 * VAL_<ORIGIN_BLOCK>_<NAME>
 */
typedef enum{
    // order must match .c _values_ arrays!
    _NIL_VAL            /// not a value, must be first
    /// start uints
    ,VAL_IRQ_0_PERVAL, 
    VAL_IRQ_0_VALUE,    // input
    VAL_IRQ_0_STATUS,  
    VAL_IRQ_1_STATUS,
    VAL_IRQ_1_PERIOD,   // input
    VAL_IRQ_1_NUM_REP,  // input
    VAL_IRQ_2_STATUS, 
    VAL_IRQ_2_PERIOD,   // input
    VAL_IRQ_2_NUM_REP,  // input
    VAL_DSP_3_STATUS,
    VAL_DSP_3_PERVAL,
    VAL_DSP_3_ID_COUNTER,
    VAL_DSP_3_VALUE,    // input
    VAL_DSP_3_PERIOD,   // input
    VAL_DSP_3_DUTY,     // input
    VAL_DSP_3_NUM_REP,  // input
    VAL_DSP_3_DELAY,    // input
    VAL_DSP_3_CLEAR_ID, // input
    /// start bools
    VAL_IRQ_0_ENABLE,   // input
    VAL_IRQ_1_CLEAR,    // input
    VAL_IRQ_2_CLEAR,    // input
    VAL_DSP_3_READY,
    VAL_DSP_3_RESET,    // input
    _NUM_VALS           /// must be last
}irqt_val_id_t;

/** 
 * List all available event types when receiving a DrvEvent
 */
typedef enum{
    EVT_T_VAL_UPDATE,   
	EVT_T_IRQ    
}irqt_event_type_t;

/**
 *  List all available value types when receiving a DrvValue
 */
typedef enum{
    _NIL_VAL_TYPE,
    VAL_T_UINT,
    VAL_T_INT,   
    VAL_T_BOOL,
    _NUM_VAL_TYPES
}irqt_val_type_t;

/**
 *  List all IRQ sources when receiving a DrvValue
 */
typedef enum{
    IRQ_0,
    IRQ_1,
    IRQ_2,
    _NUM_IRQS   /// must be last
}irqt_irq_id_t;

/**
 *  Driver Event
 */
struct DrvEvent{
    void * _reserved;   // for sending through fifo
    short cleared;      // how often read, necesary for sem + arr
    irqt_val_id_t val_id; 
    irqt_val_type_t val_type;
    irqt_event_type_t event_type;
    irqt_irq_id_t irq_id;
};

/** Driver Value. Generic parent struct to be casted to 
 *  correct subtype. This can be inferred by .val_type in 
 *  a DrvEvent.
 */
struct DrvValue_gen{
    irqt_val_id_t id_name;
    u32_t time_cyc; 
};

// "inherits" from generic DrvValue_gen
struct DrvValue_int{
    struct DrvValue_gen _super;   
    volatile int * base_addr;
    int payload;
};
struct DrvValue_uint{
    struct DrvValue_gen _super;
    volatile u32_t * base_addr;
    u32_t payload;
};
struct DrvValue_bool{
    struct DrvValue_gen _super;
    volatile bool * base_addr;
    bool payload;
};


// todo: clearify which functions need 'struct device * dev' param

int irqtester_fe310_get_val(irqt_val_id_t id_name, void * res);
int irqtester_fe310_get_val_uint(irqt_val_id_t id, void * res_value);
u32_t irqtester_fe310_get_val_uint_raw(irqt_val_id_t id);


int irqtester_fe310_get_reg(struct device * dev, irqt_val_id_t id, void * res_val);
int irqtester_fe310_set_reg(struct device * dev, irqt_val_id_t id, void * set_value);
int irqtester_fe310_set_reg_fast(struct device * dev, irqt_val_id_t id, void * set_val);
int irqtester_fe310_set_reg_uint_fast(struct device * dev, irqt_val_id_t id, void * set_val);



int irqtester_fe310_register_queue_rx(struct device * dev, struct k_msgq * queue);
int irqtester_fe310_register_fifo_rx(struct device * dev, struct k_fifo * queue);
int irqtester_fe310_register_sem_arr_rx(struct device * dev, struct k_sem * sem, struct DrvEvent evt_arr[], int len);

int irqtester_fe310_enable_queue_rx(struct device * dev);
int irqtester_fe310_enable_valflags_rx(struct device * dev);
int irqtester_fe310_enable_fifo_rx(struct device * dev);
int irqtester_fe310_enable_sem_arr_rx(struct device * dev);

int irqtester_fe310_receive_evt_from_arr(struct device * dev, struct DrvEvent * res, s32_t timeout);

int irqtester_fe310_purge_rx(struct device * dev);

bool irqtester_fe310_test_valflag(struct device *dev, irqt_val_id_t id_name);
void irqtester_fe310_clear_all_valflags(struct device *dev);

void irqtester_fe310_dbgprint_event(struct device * dev, struct DrvEvent * evt);

int irqtester_fe310_fire(struct device *dev);
void irqtester_fe310_fire_1(struct device *dev);
int irqtester_fe310_fire_2(struct device *dev);
void irqtester_fe310_clear_1(struct device *dev);
void irqtester_fe310_clear_2(struct device *dev);

// semi private
int irqtester_fe310_register_callback(struct device *dev, irqt_irq_id_t irq_id, void (*cb)(void));
int irqtester_fe310_unregister_callback(struct device *dev, irqt_irq_id_t irq_id);




// todo: make private
/*
int irqtester_fe310_set_value(struct device *dev, unsigned int val);



int irqtester_fe310_get_value(struct device *dev, unsigned int * res);

int irqtester_fe310_get_status(struct device *dev, unsigned int * res);
*/
int irqtester_fe310_enable(struct device *dev);
int irqtester_fe310_get_perval(struct device *dev, unsigned int * res);
int irqtester_fe310_get_enable(struct device *dev, bool * res);
int irqtester_fe310_disable(struct device *dev);


// for tests only, todo: make static inline
void _irq_gen_handler(void);

void _irq_0_handler_1(void);
void _irq_0_handler_2(void);
void _irq_0_handler_3(void);
void _irq_0_handler_4(void);
void _irq_0_handler_5(void);
void _irq_0_handler_6(void);

void _irq_1_handler_0(void);
void _irq_1_handler_1(void);

void _irq_2_handler_0(void);
void _irq_2_handler_1(void);


#endif
```

## src/log_perf.c
```c
#include "log_perf.h"
#include "utils.h"
#include <misc/printk.h>


// takes a lot space in data segment, so try to keep short
#define LOG_PERF_BUFFER_DEPTH 10
#define LOG_PERF_STRING_LEN 60

typedef char logline[LOG_PERF_STRING_LEN];
logline log_buff[LOG_PERF_BUFFER_DEPTH];

typedef int logline_int[2];
logline_int log_intbuff[LOG_PERF_BUFFER_DEPTH];

static int i_log_call;
static int i_logint_call;

void print_to_buf(const char *fmt, ...){
    va_list args;
    va_start(args, fmt);

    vsnprintk(log_buff[i_log_call % LOG_PERF_BUFFER_DEPTH], LOG_PERF_STRING_LEN, fmt, args); 
    i_log_call++; 

    va_end(args);
}

void save_to_intbuf(int id, int msg){
    log_intbuff[i_logint_call % LOG_PERF_BUFFER_DEPTH][0] = id;
    log_intbuff[i_logint_call % LOG_PERF_BUFFER_DEPTH][1] = msg;
    i_logint_call++; 
}

static void purge_buff(){

    for(int i=0; i<LOG_PERF_BUFFER_DEPTH; i++){
        log_intbuff[i][0] = 0;
        log_intbuff[i][1] = 0;
        vsnprintk(log_buff[i], LOG_PERF_STRING_LEN, "", NULL);
    }

    i_log_call = 0;
}

void print_buff(){
    int len = (i_log_call < LOG_PERF_BUFFER_DEPTH ? i_log_call : LOG_PERF_BUFFER_DEPTH); 
    int len_int = (i_logint_call < LOG_PERF_BUFFER_DEPTH ? i_logint_call : LOG_PERF_BUFFER_DEPTH); 
    

    //printk("i_log_calls %u \n", i_log_call);
    printk("Printing LOG_PERF buffer: \n");
    for(int i=0; i<len; i++){
        printk("%s\n", log_buff[i]);
    }
    printk("Printing LOG_PERF int buffer: \n");
    for(int i=0; i<len_int; i++){
        printk("[%i] %i\n", log_intbuff[i][0], log_intbuff[i][1]);
    } 

    purge_buff();
}
```

## src/log_perf.h
```c
/**
 * @file 
 * @brief  Implements a performance logging method which prints
 *          to a fifo string buffer instead of uart.
 */

#ifndef LOG_PERF_H
#define LOG_PERF_H

#include <misc/printk.h>





void print_to_buf(const char *fmt, ...);
void print_buff();
void save_to_intbuf(int id, int msg);


#define LOG_PERF(...) \
    print_to_buf(__VA_ARGS__)

#define LOG_PERF_INT(id, x) \
    save_to_intbuf(id, x)

#define PRINT_LOG_BUFF() do{\
    print_buff(); \
}while(0)
#endif
```

## src/profiler.h
```c
/**
 * @file
 * @brief  Simple statistical profiler employing periodic IRQ
 *          of irqtestperipheral hardware.
 */

#ifndef PROFILER_H
#define PROFILER_H

#include "zephyr.h"

void profiler_enable(u32_t period_cyc);
void profiler_start();
void profiler_stop();

#endif
```

## src/state_manager.h
```c
/**
 * @file
 * @brief  Generic logic for running a state machine. Concrete implementation 
 *         happens elsewhere.
 */

#ifndef STATE_MANAGER_H
#define STATE_MANAGER_H

#include <device.h>
#include "states.h"
#include "irqtestperipheral.h"


typedef enum{
    _NIL_RS,
    RS_WAIT_FOR_START,
    RS_WAIT_FOR_VAL,
    _NUM_WAIT_REASON
}sm_wait_reason_t;



// todo: all threadsafe, repeated call safe?

void state_mng_configure(struct State cust_states[], cycle_state_id_t * cust_tt, int len_states, int len_events);
void state_mng_init(struct device * dev);
void state_mng_print_state_config();
void state_mng_print_transition_table_config();
int state_mng_pull_perf_action(int res_buff[], int idx_buf, int len); 

bool state_mng_is_running();
cycle_state_id_t state_mng_get_current();
u8_t state_mng_get_current_subs();
struct State * state_mng_id_2_state(cycle_state_id_t id_name);

u32_t state_mng_get_time_delta();
int state_mng_get_timing_goal(struct State * state, u8_t substate, int mode);

void state_mng_run(void);   
int state_mng_start();
int state_mng_abort();

int state_mng_register_action(cycle_state_id_t state_id, void (*func)(struct ActionArg const *), irqt_val_id_t arr_vals[], int len);
int state_mng_purge_registered_actions(cycle_state_id_t state_id);
int state_mng_purge_registered_actions_all();

void state_mng_wait_fix(struct State * state, u32_t t_fix, sm_wait_reason_t reason);
bool state_mng_wait_vals_ready(struct State * state);

void state_mng_print_evt_log();

#endif
```

## src/states.c
```c
#ifndef TEST_MINIMAL
#include "states.h"
#include "state_manager.h"

#define SYS_LOG_DOMAIN "States"  
#define SYS_LOG_LEVEL SYS_LOG_LEVEL_DEBUG
#include <logging/sys_log.h>
#include <string.h>

/*
* Define states
* Use state_manager::register_action() to set additional
* state actions and required values.
*-----------------------------------------------------------------------------
*/

static struct State s_idle = {.id_name = CYCLE_STATE_IDLE, .default_next_state = CYCLE_STATE_IDLE,
        .timing_goal_start = 0, .timing_goal_end = 0,  
        };

static struct State s_start = {.id_name = CYCLE_STATE_START, .default_next_state = CYCLE_STATE_END,
        .timing_goal_start = 0, .timing_goal_end = 0,  
        };

static struct State s_end = {.id_name = CYCLE_STATE_END, .default_next_state = CYCLE_STATE_IDLE,
        .timing_goal_start = 0, .timing_goal_end = 0, 
        };

/**
 * @brief: Set up state array and transition table automatically. 
 * 
 * Uses states hard-coded in states.c
 * Registers a default action handler to every state, which is a function
 * that is responsible to fire all registered callbacks. 
 */
void states_configure_auto(struct State * states, cycle_state_id_t * transition_table, void * action){
    // non thread safe, never call if running
    // cast to pointers to array with correct dimensions
    struct State (*states_p)[_NUM_CYCLE_STATES]  = (struct State (*)[_NUM_CYCLE_STATES])states;
    cycle_state_id_t (*tt_p)[_NUM_CYCLE_STATES][_NUM_CYCLE_EVENTS] = (cycle_state_id_t (*)[_NUM_CYCLE_STATES][_NUM_CYCLE_EVENTS]) transition_table;

    // set (usually default) action handler, argument is casted to correct function type 
    s_idle.action =     (void (*)(cycle_state_id_t))action;
    s_start.action =    (void (*)(cycle_state_id_t))action;
    s_end.action =      (void (*)(cycle_state_id_t))action;

    // initialize array for safety
    for(int i=0; i<STATES_REQ_VALS_MAX; i++){
        s_idle.val_ids_req[i] = _NIL_VAL;
        s_start.val_ids_req[i] = _NIL_VAL;
        s_end.val_ids_req[i] = _NIL_VAL;
    }

     // manually set up all states[_NUM_CYCLE_STATES] as defined in enum cycle_state_id_t
    (*states_p)[CYCLE_STATE_IDLE] = s_idle;
    (*states_p)[CYCLE_STATE_START] = s_start;
    (*states_p)[CYCLE_STATE_END] = s_end;

    // manually set up transition table[_NUM_CYCLE_STATES][_NUM_CYCLE_EVENTS]
    // for CYCLE_STATE_IDLE
    cycle_event_id_t t0[_NUM_CYCLE_EVENTS] = \
        {(*states_p)[CYCLE_STATE_IDLE].default_next_state, CYCLE_STATE_START};  
    (*tt_p)[CYCLE_STATE_IDLE][_CYCLE_DEFAULT_EVT] = t0[0];   
    (*tt_p)[CYCLE_STATE_IDLE][CYCLE_EVENT_RESET_IRQ] = t0[1];  
    // for CYCLE_STATE_START    
    cycle_event_id_t t1[_NUM_CYCLE_EVENTS] = \
        {(*states_p)[CYCLE_STATE_START].default_next_state, CYCLE_STATE_START};  
    (*tt_p)[CYCLE_STATE_START][_CYCLE_DEFAULT_EVT] = t1[0];   
    (*tt_p)[CYCLE_STATE_START][CYCLE_EVENT_RESET_IRQ] = t1[1];   
    // for CYCLE_STATE_END        
    cycle_event_id_t t2[_NUM_CYCLE_EVENTS] = \
        {(*states_p)[CYCLE_STATE_END].default_next_state, CYCLE_STATE_START};  
    (*tt_p)[CYCLE_STATE_END][_CYCLE_DEFAULT_EVT] = t2[0];   
    (*tt_p)[CYCLE_STATE_END][CYCLE_EVENT_RESET_IRQ] = t2[1];   

}

/**
 * @brief: Set up state array and transition table of state manager by customnly deployed arrays. 
 * 
 * Registers a default action handler to every state, which is a function
 * that is responsible to fire all registered callbacks. 
 * Non thread safe, never call if sm running
 * 
 * @param states:           Pointer to state_manager state array.
 * @param transition_table: Pointer to state_manager transition_table.
 * @param action:           Function pointer (void-2-void) to default action, usually state manager action dispatcher.
 * @param cust_states[]:    All states to be configured to state machine. Must be static var. todo: really? Copying into sm?
 * @param cust_tt[]:        Transition table to be configure to state machine. Must be static var.
 */
void states_configure_custom(struct State * states, cycle_state_id_t * transition_table, void * action, \
                                struct State cust_states[], cycle_state_id_t * cust_tt, int len_states, int len_events){
    
    // cast to pointers to array with correct dimensions
    struct State (*states_p)[_NUM_CYCLE_STATES]  = (struct State (*)[_NUM_CYCLE_STATES])states;
    cycle_state_id_t (*tt_p)[_NUM_CYCLE_STATES][_NUM_CYCLE_EVENTS] = (cycle_state_id_t (*)[_NUM_CYCLE_STATES][_NUM_CYCLE_EVENTS]) transition_table;
    cycle_state_id_t (*cust_tt_p)[_NUM_CYCLE_STATES][_NUM_CYCLE_EVENTS] = (cycle_state_id_t (*)[_NUM_CYCLE_STATES][_NUM_CYCLE_EVENTS]) cust_tt;

    if(_NUM_CYCLE_STATES != len_states){
        SYS_LOG_WRN("Provided custom state must be of size _NUM_CYCLE_STATES.");
        return;
    }
    if(_NUM_CYCLE_EVENTS != len_events){
        SYS_LOG_WRN("Provided transition table must have dimension 1 == _NUM_EVENTS_STATES.");
        return;
    }

    // set (usually default) action handler, argument is casted to correct function type 
    for(int i=0; i<len_states; i++)
        cust_states[i].action = (void (*)(cycle_state_id_t))action;

    // copy into state_manger states array
    memcpy(*states_p, cust_states, len_states * sizeof(*states)) ;

    for(int i=0; i<len_states; i++){
        for(int j=0; j<len_events; j++){
            // copy into state_manager transition table
            (*tt_p)[i][j] = (*cust_tt_p)[i][j];
        }
        // set up default (NULL event) transition
        (*tt_p)[i][0] = (*states_p)[i].default_next_state;   // states arr must have been filled before
    }
}

/**
 * @brief: Configure given state with serial substates.
 * todo: make safe while sm running
 */
void states_configure_substates(struct State * state, u8_t num_substates, u8_t timing_summand){
    if(num_substates < 1){
        SYS_LOG_WRN("Invalid number of substates %i, set to 1", num_substates);
        num_substates = 1;
    }
    state->max_subs_idx = num_substates - 1;    // idx 0 counts as substate
    state->timing_summand = timing_summand;
}


void states_print_state(struct State * state){
    printk("Printing state struct: \n");
    printk("id: %i \ndefault_next: %i \ngoal_start: %u \ngoal_end: %u \nval_ids_req \n", \
            state->id_name, state->default_next_state,     \
            state->timing_goal_start, state->timing_goal_end);
    print_arr_uint(0, state->val_ids_req, STATES_REQ_VALS_MAX);
    printk("action: %p \n", state->action);

}


int states_get_timing_goal_start(struct State * state, u8_t substate){
    
   
    int result = state->timing_goal_start;   

    // substate logic
    // replicate duration of parent state + summand
    #if(STATES_DIS_SUBSTATES == 0)
    if(likely(state->max_subs_idx > 0))
        result += substate * (state->timing_goal_end - state->timing_goal_start + state->timing_summand);
    #endif

    return result;
}

int states_get_timing_goal_end(struct State * state, u8_t substate){
    
    int result = state->timing_goal_end;

    // substate logic
    // replicate duration of parent state + summand
    #if(STATES_DIS_SUBSTATES == 0)
    if(likely(state->max_subs_idx > 0))
        result += substate * (state->timing_goal_end - state->timing_goal_start + state->timing_summand) ;
    #endif

    return result;
}


#endif // TEST_MINIMAL
```

## src/states.h
```c
/**
 * @file
 * @brief define state machine 'state' struct and configure to state_manager
 */


#ifndef STATES_H
#define STATES_H

#include <zephyr.h>
#include "irqtestperipheral.h"

#define STATES_REQ_VALS_MAX         5    // might need adjustment if many vals
#define STATES_CBS_PER_ACTION_MAX   5
//#define STATES_SUBSTATE_SER_DEPTH   3   
#define STATES_DIS_SUBSTATES 0      // 1 to deactivate substates  

typedef enum{
    CYCLE_STATE_IDLE,
    CYCLE_STATE_START, // aka preamble detect
    CYCLE_STATE_DL_CONFIG,
    CYCLE_STATE_DL,
    CYCLE_STATE_UL_CONFIG,
    CYCLE_STATE_UL,
    CYCLE_STATE_RL_CONFIG,
    CYCLE_STATE_RL,
    CYCLE_STATE_END,
    _NUM_CYCLE_STATES // must be last

}cycle_state_id_t;

typedef enum{
    _CYCLE_DEFAULT_EVT, // must be first -> call next state as define by element 0 of transition table
    CYCLE_EVENT_RESET_IRQ,
    _NUM_CYCLE_EVENTS // must be last

}cycle_event_id_t;


struct State{
    cycle_state_id_t id_name;
    cycle_state_id_t default_next_state;
    u32_t timing_goal_start; // in cpu cycles
    u32_t timing_goal_end;
    irqt_val_id_t val_ids_req[STATES_REQ_VALS_MAX];  // holds the irqt vals requested by state
    void (*action)(cycle_state_id_t);  // method called when switched to this state , note that usually _default_action()
    void (*handle_t_goal_start)(struct State *, int);  // method called when entering state, to act when time goal hit / missed    
    void (*handle_t_goal_end)(struct State *, int);    // method called when leaving state, to act when time goal hit / missed
    bool (*handle_val_rfail)(struct State *);    // called when check_vals_ready fails at beginning of state, returns true if actions should be skipped

    // serial substates logic: automatically invoked as next state
    // until all substates have occured (eg. for multiple user time slots)
    // they "inherit" all states var but modify timing goals
    // affects state_manager::switch_state() and ::check_time_goal()
    u8_t cur_subs_idx;
    u8_t max_subs_idx;
    u32_t timing_summand;  // added to timing_goals additionaly to duration of state
};

/// struct passed to any registered action as argument
struct ActionArg{
    struct State * state_cur;
};



void states_configure_auto(struct State * states, cycle_state_id_t * transition_table, void * action);
void states_configure_custom(struct State * states, cycle_state_id_t * transition_table, void * action, \
                                struct State cust_states[], cycle_state_id_t * cust_tt, int len_states, int len_events);
void states_configure_substates(struct State * state, u8_t num_substates, u8_t timing_summand);

int states_get_timing_goal_start(struct State * state, u8_t substate);
int states_get_timing_goal_end(struct State * state, u8_t substate);

void states_print_state(struct State * state);

#endif
```
