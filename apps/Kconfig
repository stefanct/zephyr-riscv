## apps/Kconfig
```kconfig
# Kconfig - application dirver configuration options
# this Kconfig file has to be sourced in <root>/Kconfig.zephyr


menuconfig APP_DRIVERS
	bool
	prompt "Application drivers"
	default n
	help
	Enable options for drivers from application build dirs.


if APP_DRIVERS
# currently app drivers have to live in application dir
# might consider building drivers as libs instead
source "apps/irqperipheral_test/src/drivers/*/Kconfig.*"
endif

menuconfig APP_SETTINGS
	bool
	prompt "Application settings"
	default n
	help
	Enable the configuration of different settings for apps.


if APP_SETTINGS
	source "apps/irqperipheral_test/src/Kconfig.*"
endif
```

## apps/hello/src/drivers/fpga-zynq_console/Kconfig.zc706
```kconfig
menuconfig FPGAZYNQ_UART_DRIVER
	bool "fpga-zynq serial driver enabled"
	depends on SOC_RISCV32_ZC706
	default n
	select SERIAL
	select SERIAL_HAS_DRIVER
	select CONSOLE_HAS_DRIVER
	select UART_CONSOLE

	help
	  This option enables the zc706 fake serial driver for communication with fesvr.
	  Application driver, will not be listed in device driver menuconfig.
	  Remember to set the console driver for output, too.

if FPGAZYNQ_UART_DRIVER

menuconfig UART_FPGAZYNQ_NAME
	string "Device name of fesvr uart driver. Mind setting console driver, too."
	depends on FPGAZYNQ_UART_DRIVER
	default "uart-fesvr0"
	
endif

# this forces overrite of value,
# usually set in menuconfig drivers/console
#if FPGAZYNQ_UART_DRIVER
#config UART_CONSOLE_ON_DEV_NAME
#	string
#	prompt "Name of uart device for console output"
#	default UART_FPGAZYNQ_NAME
#endif
```

## apps/irqperipheral_test/src/drivers/irqtestperipheral/Kconfig.fe310
```kconfig
# may use the FE310 driver also for zc706, mind to configure settings accordingly!
menuconfig FE310_IRQT_DRIVER
	bool "IrqTestPeripheral driver enabled"
	depends on SOC_RISCV32_FE310 || SOC_RISCV32_ZC706
	default n

config FE310_IRQT_NAME
	string "Device name of irqt driver"
	depends on FE310_IRQT_DRIVER
	default "irqtester0"

config FE310_IRQT_FAST_ID2IDX
	bool "Enable fast translation from id to idx. No bound checking!"
	depends on FE310_IRQT_DRIVER
	default 0

config FE310_ISR_PLIC_OPT_LVL
	int "Level of ISR optimization for PLIC IRQ handling"
	depends on FE310_IRQT_DRIVER
	default 0

config FE310_IRQT_IRQ_0_PIN
	int "Pin of IRQ0 of IrqTestPeripheral"
	depends on FE310_IRQT_DRIVER
	default 53
	help 
	As given in rocket interrupt map
```

## arch/riscv32/soc/riscv-privilege/fe310/Kconfig.defconfig.series
```kconfig
if SOC_SERIES_RISCV32_FE310

config SOC_SERIES
	string
	default "fe310"

config SYS_CLOCK_HW_CYCLES_PER_SEC
	int
	default 32786

config RISCV_SOC_INTERRUPT_INIT
	bool
	default y

config RISCV_HAS_CPU_IDLE
	bool
	default y

config RISCV_HAS_PLIC
	bool
	default y

config NUM_IRQS
	int
	default 67

config XIP
	bool
	default y

config RISCV_ROM_BASE_ADDR
	hex
	default 0x20400000

config RISCV_ROM_SIZE
	hex
	default 0xC00000

config RISCV_RAM_BASE_ADDR
	hex
	default	0x80000000

config RISCV_RAM_SIZE
	hex
	default 0x10000

config FE310_IRQT_DRIVER
	bool "IrqTestPeripheral Driver enabled"
	depends on SOC_RISCV32_FE310
	default y

config FE310_ISR_PLIC_OPT_LVL
	int "Level of ISR optimization for PLIC IRQ handling"
	depends on SOC_RISCV32_FE310
	default 0

endif # SOC_SERIES_RISCV32_FE310
```
