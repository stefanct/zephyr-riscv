## prj.conf
```kconfig
# WARNING:  check that no unecessary spaces before/after values!
# WARNING:  'make clean BOARD=x' after altering this file
# WARNING:  some values might be overriden by other dependencies 
#           double check in outdir/.config: NUM_IRQS, CONFIG_RISCV_RAM_SIZE
#           if not correct, set in arch/riscv32/soc/riscv-privilege/fe310/Kconfig.defconfig.series
CONFIG_NUM_IRQS=67
CONFIG_SYS_LOG=y
CONFIG_RISCV_RAM_SIZE=0x8000
```

## src/main.c
```c
#include <zephyr.h>
#include <misc/printk.h>
#include <device.h>

#include "globals.h"
#include "irqtestperipheral.h"
#include "tests/test_runners.h"
#include "tests/tests.h"
#include "cycles.h"
#include "log_perf.h"
#include "utils.h"
#include "globals.h"

#include "state_manager.h"
#ifndef TEST_MINIMAL
#include <string.h>
#endif
#include "state_machines/sm1.h"




// set driver names in Kconfig
#define IRQTESTER_DRV_NAME "irqtester0"
#define UART1_DRV_NAME "uart0"			// 1st uart on PMOD J58 header
#define UART2_DRV_NAME "uart1"			// 2nd uart on PMOD J58 header
#define IRQTESTER_HW_REV 3


int global_max_cyc;


// copy of disabled function in devices.c
extern struct device __device_init_end[];
extern struct device __device_init_start[];
void device_list_get(struct device **device_list, int *device_count)
{

	*device_list = __device_init_start;
	*device_count = __device_init_end - __device_init_start;
}

// attention: uses "heavy" strcmp
void print_device_drivers(){
	#ifndef TEST_MINIMAL
	struct device *dev_list_buf;
	int len;

	device_list_get(&dev_list_buf, &len);

	printk("Found %i device drivers: \n", len);
	for(int i=0; i<len; i++){
		char * name = dev_list_buf[i].config->name;
		printk("%s @ %p, ", (strcmp("", name) == 0 ? "<unnamed>" : name), dev_list_buf[i].config->config_info);
	}
	printk("\n");
	#endif
}


void print_kernel_info(){
	#ifndef TEST_MINIMAL
	#ifndef CONFIG_PREEMPT_ENABLED
	#define PRINT_CONFIG_PREEMPT_ENABLED 0
	#else
	#define PRINT_CONFIG_PREEMPT_ENABLED CONFIG_PREEMPT_ENABLED
	#endif
	#ifndef CONFIG_TIMESLICING
	#define PRINT_CONFIG_TIMESLICING 0
	#else
	#define PRINT_CONFIG_TIMESLICING CONFIG_TIMESLICING
	#endif
	#ifndef CONFIG_IRQ_OFFLOAD
	#define PRINT_CONFIG_IRQ_OFFLOAD 0
	#else
	#define PRINT_CONFIG_IRQ_OFFLOAD CONFIG_IRQ_OFFLOAD
	#endif
	u32_t t_rtc = k_cycle_get_32();
	u32_t t_cyc = get_cycle_32();
	printk("Boot finished on %s at rtc / cycles: [%u / %u] \n", CONFIG_ARCH, t_rtc, t_cyc);
	printk("Kernel Config Info:" \
		"\nMain thread @%p prio: %i \nTimeslicing: %i \nPreempt: %i \nIRQ_offloading: %i\n", 
		k_current_get(), CONFIG_MAIN_THREAD_PRIORITY, PRINT_CONFIG_TIMESLICING,
		PRINT_CONFIG_PREEMPT_ENABLED, PRINT_CONFIG_IRQ_OFFLOAD);
	
	// driver specific
	#if CONFIG_FE310_IRQT_DRIVER
	printk("isr.S optimization: %i\n", CONFIG_FE310_ISR_PLIC_OPT_LVL);
	#endif
	#endif // TEST_MINIMAL
}

// vars main declaration in globals.h, define here
struct device * g_dev_irqt;
struct device * g_dev_uart0;
struct device * g_dev_uart1;
void load_drivers(){
	// get driver handles
	g_dev_irqt = device_get_binding(IRQTESTER_DRV_NAME);

	g_dev_uart0 = device_get_binding(UART1_DRV_NAME);
	g_dev_uart1 = device_get_binding(UART2_DRV_NAME);

	if (!g_dev_irqt) {
		printk("Cannot find driver %s!\n", IRQTESTER_DRV_NAME);
		return;
	}

	if (!g_dev_uart0) {
		printk("Cannot find driver %s!\n", UART1_DRV_NAME);
		return;
	}
	if (!g_dev_uart1) {
		printk("Cannot find driver %s!\n", UART2_DRV_NAME);
		return;
	}

}



void main(void)
{	
	/**
	 * Printing policy
	 * a) logging (SYS_LOG_<>) 
	 *    stuff that should vanish in time-critical builds
	 * 	  -> can be thrown out of code by Kconfig/logging
	 * b) (verbsoity controlled) printkv 
	 *    stuff in tests that is not time critical
	 * 	  -> can control via print_set_verbosity 
	 *    -> stays in binary, even when vebosity set to not show
	 * 	  -> productive code should avoid compiling test code anyway
	 * c) buffered LOG_PERF
	 *    stuff inside time-critical code that needs to be printed for debug
	 *    -> logs to buffer and prints after run
	 *    -> still slower than not printing, better than serial out
	 *    -> set CONFIG_APP_LOG_PERF_BUFFER_DEPTH=0 to deactivate
	 */

	bool quick_test = false;

	print_kernel_info();
	print_device_drivers();
	load_drivers();

	print_set_verbosity(1);
	
	/* rx/tx test for uart0 */
	test_uart_1(g_dev_uart0, g_dev_uart1);
	
	printk("Starting irqtester test for hw rev. %i\n", IRQTESTER_HW_REV);
	irqtester_fe310_enable(g_dev_irqt);
	
	/* basic irqt hardware check */
	run_test_hw_basic_1(g_dev_irqt);	
	/* isr up-passing */
	if(!quick_test)
		run_test_timing_rx(g_dev_irqt);


	/* irq troughput tests (inaccurate!) */
	if(!quick_test){
		//run_test_irq_throughput_3_autoadj(g_dev_irqt);	// todo: hangs with logging on
		//run_test_irq_throughput_2(g_dev_irqt);
		run_test_irq_throughput_1(g_dev_irqt);
	}
		
	/* state_manager basic test */
	if(!quick_test)
		run_test_state_mng_1(g_dev_irqt);

	/* template sm 
	   make sure to #define SMT_ENABLE in sm_template.c */
	//sm_t_run();

	/* state_manager throughputs 
	   make sure to #define SM1_ENABLE in sm1.c
	*/
	//print_set_verbosity(2);
	//run_test_sm1_throughput_1(g_dev_irqt);	// irq1 (reset) throughput
	//run_test_sm_throughput_2(g_dev_irqt, 1);	// irq2 (val updt) throughput for sm1
	//run_test_sm_throughput_2(g_dev_irqt, 2);	// irq2 (val updt) throughput for sm2


	/* benchmark of state_manager, used for execution time model calibration */
	//run_test_sm2_action_perf_3(g_dev_irqt);

	/* used for profiling state_manager */
	//run_test_sm2_action_prof_4(g_dev_irqt);

	/* continous bench timing of state_manager critical loop */
	int i=0;
	int n_runs = 10;
	global_max_cyc = -1;
	print_set_verbosity(2);
	do{
		i++;
		run_test_state_mng_2(g_dev_irqt);
		printk("[%i/%i] in main loop, global max %i \n", i, n_runs, global_max_cyc);

	}while(i < n_runs);
	

	printk("Total uptime / init time  %u ms \n", k_uptime_get_32());
	printk("***** Main thread: I'm done here... Goodbye! ***** \n");
	while(1){
		k_yield();
	}
	return; // end main thread
}
```

## src/globals.h
```c
/**
 * @file
 * @brief Global shared variables, mainly devices handles.
 * 
 * By convention, write from main.c only.
 */

#include <device.h>

extern struct device * g_dev_irqt;
extern struct device * g_dev_uart0;
extern struct device * g_dev_uart1;
```

## src/log_perf.c
```c
#include "log_perf.h"
#include "utils.h"
#include <misc/printk.h>
#include <logging/sys_log.h>

#define SYS_LOG_DOMAIN "log_perf"  
#include <logging/sys_log.h>

#ifndef TEST_MINMAL


typedef char logline[LOG_PERF_STRING_LEN];
logline log_buff[LOG_PERF_BUFFER_DEPTH];

typedef int logline_int[2];
logline_int log_intbuff[LOG_PERF_BUFFER_DEPTH];

static int i_log_call;
static int i_logint_call;

void print_to_buf(const char *fmt, ...){

    #if(LOG_PERF_BUFFER_DEPTH == 0)
        return;
    #else
    

    va_list args;
    va_start(args, fmt);

    vsnprintk(log_buff[i_log_call % LOG_PERF_BUFFER_DEPTH], LOG_PERF_STRING_LEN, fmt, args); 
    i_log_call++; 

    va_end(args);
    #endif
}

void save_to_intbuf(int id, int msg){
    #if(LOG_PERF_BUFFER_DEPTH == 0)
    return;
    #else

    log_intbuff[i_logint_call % LOG_PERF_BUFFER_DEPTH][0] = id;
    log_intbuff[i_logint_call % LOG_PERF_BUFFER_DEPTH][1] = msg;
    i_logint_call++; 
    #endif
}

static void purge_buff(){

    for(int i=0; i<LOG_PERF_BUFFER_DEPTH; i++){
        log_intbuff[i][0] = 0;
        log_intbuff[i][1] = 0;
        vsnprintk(log_buff[i], LOG_PERF_STRING_LEN, "", NULL);
    }

    i_log_call = 0;
}

void print_buff(int verb){
    #if(LOG_PERF_BUFFER_DEPTH == 0)
        SYS_LOG_WRN("Printing zero-sized log buffer. Check Kconfig. \n");
        return;
    #endif

    int len = (i_log_call < LOG_PERF_BUFFER_DEPTH ? i_log_call : LOG_PERF_BUFFER_DEPTH); 
    int len_int = (i_logint_call < LOG_PERF_BUFFER_DEPTH ? i_logint_call : LOG_PERF_BUFFER_DEPTH);   

    //printk("i_log_calls %u \n", i_log_call);
    printkv(verb, "Printing LOG_PERF buffer: \n");
    for(int i=0; i<len; i++){
        printkv(verb, "%s\n", log_buff[i]);
    }
    printkv(verb, "Printing LOG_PERF int buffer: \n");
    for(int i=0; i<len_int; i++){
        printkv(verb, "[%i] %i\n", log_intbuff[i][0], log_intbuff[i][1]);
    } 

    purge_buff();
}

#endif // TEST_MINIMAL
```

## src/log_perf.h
```c
/**
 * @file 
 * @brief  Implements a performance logging method which prints
 *         to a fifo string buffer instead of uart.
 * 
 * Faster than SYS_LOG (UART), but still slow! (~ 5000 cyc)
 */

#ifndef LOG_PERF_H
#define LOG_PERF_H

#include <misc/printk.h>


// takes a lot space in data segment, so try to keep short
#define LOG_PERF_BUFFER_DEPTH CONFIG_APP_LOG_PERF_BUFFER_DEPTH      // 10
#define LOG_PERF_STRING_LEN CONFIG_APP_LOG_PERF_STRING_LEN          // 60


void print_to_buf(const char *fmt, ...);
void print_buff();
void save_to_intbuf(int id, int msg);

#if LOG_PERF_BUFFER_DEPTH == 0
#define LOG_PERF(...){;}
#else
#define LOG_PERF(...) \
    print_to_buf(__VA_ARGS__)
#endif

#if LOG_PERF_BUFFER_DEPTH == 0
#define LOG_PERF_INT(id, x){;}
#else
#define LOG_PERF_INT(id, x) \
    save_to_intbuf(id, x)
#endif

#define PRINT_LOG_BUFF(verb) do{\
    print_buff(verb); \
}while(0)
#endif
```

## src/profiler.c
```c
#include "profiler.h"
#include "irqtestperipheral.h"
#include "globals.h"

#ifndef TEST_MINIMAL

static u32_t log_pc[PROFILER_BUF_DEPTH];



static void dump_2_console(){
    printk("{[");
    for(int i=0; i<PROFILER_BUF_DEPTH; i++){
        printk("%p,\n", (void *)log_pc[i]);
    }
    printk("]}\n");
}


static u32_t i_call_isr;
static void irq_handler_profiler_1(){
    
    // get program counter when interrupt detected
    u32_t pc;
	__asm__ volatile("csrr %0, mepc" : "=r" (pc));

    log_pc[i_call_isr] = pc;
    i_call_isr++;

    if(i_call_isr >= PROFILER_BUF_DEPTH){
        i_call_isr = 0;
        // deactivate irq2 interrupt to avoid error code
        // in status register
        struct DrvValue_uint reg_num = {.payload=0};
        struct DrvValue_uint reg_period = {.payload=0};	
        irqtester_fe310_get_reg(g_dev_irqt, VAL_IRQ_2_PERIOD, &reg_period);
        irqtester_fe310_get_reg(g_dev_irqt, VAL_IRQ_2_NUM_REP, &reg_num);
        u32_t save_num = reg_num.payload;
        u32_t save_period = reg_period.payload;
        
        dump_2_console();

        // activate again
        reg_period.payload = save_period;
        reg_num.payload = save_num;
        irqtester_fe310_set_reg(g_dev_irqt, VAL_IRQ_2_PERIOD, &reg_period);
        irqtester_fe310_set_reg(g_dev_irqt, VAL_IRQ_2_NUM_REP, &reg_num);
    }

    irqtester_fe310_clear_2(g_dev_irqt);
    // fire in case of deactived, else no effect
    irqtester_fe310_fire_2(g_dev_irqt);
}

/**
 * @brief:  Enable sampling of program counter via a irq..
 *          Call _start() afterwards.
 *  
 * - IRQ is registered on irqtestperipheral/IRQ2. Make this
 *   hw is not used otherwise
 * - Automatically dumps output to console. Avoid other 
 *   output
 *  
 */

void profiler_enable(u32_t period_cyc){
    struct DrvValue_uint reg_num = {.payload=UINT32_MAX};
	struct DrvValue_uint reg_period = {.payload=period_cyc};	

	irqtester_fe310_set_reg(g_dev_irqt, VAL_IRQ_2_NUM_REP, &reg_num);
	irqtester_fe310_set_reg(g_dev_irqt, VAL_IRQ_2_PERIOD, &reg_period);

    irqtester_fe310_register_callback(g_dev_irqt, 2, irq_handler_profiler_1);

}

void profiler_start(){
    irqtester_fe310_fire_2(g_dev_irqt);
}

void profiler_stop(){
    struct DrvValue_uint reg_num = {.payload=0};
	struct DrvValue_uint reg_period = {.payload=0};	

	irqtester_fe310_set_reg(g_dev_irqt, VAL_IRQ_2_NUM_REP, &reg_num);
	irqtester_fe310_set_reg(g_dev_irqt, VAL_IRQ_2_PERIOD, &reg_period);

    irqtester_fe310_unregister_callback(g_dev_irqt, 2);

}

#endif // TEST_MINIMAL
```

## src/profiler.h
```c
/**
 * @file
 * @brief  Simple statistical profiler employing periodic IRQ
 *          of irqtestperipheral hardware.
 */

#ifndef PROFILER_H
#define PROFILER_H

#include "zephyr.h"

#define PROFILER_BUF_DEPTH CONFIG_APP_PROFILER_BUF_DEPTH    // 1000, reasonable if activated


void profiler_enable(u32_t period_cyc);
void profiler_start();
void profiler_stop();

#endif
```

## src/state_manager.h
```c
/**
 * @file
 * @brief  Logic for running a state machine. 
 *
 * Modified table-based, event-driven state machine from here
 * http://www.pezzino.ch/state-machine-in-c/
 * - actions are not connected to transitions but the single states
 * - events are gathered over the whole current state
 *   highest prio event determines transitions
 * - if no event: default transition is defined for every state
 * 
 * Currently:
 * - Singleton, don't use to set up >1 state machines.
 * - Designed to be only or cooperative thread. Behaviour unclear if not.
 * 
 */

#ifndef STATE_MANAGER_H
#define STATE_MANAGER_H

#include <device.h>
#include "states.h"
#include "irqtestperipheral.h"


typedef enum{
    _NIL_RS,
    RS_WAIT_FOR_START,
    RS_WAIT_FOR_VAL,
    _NUM_WAIT_REASON
}sm_wait_reason_t;

/// used for logging
struct Switch_Event{
    cycle_state_id_t from_state;
    u8_t from_substate;
    cycle_state_id_t to_state;
    u8_t to_substate;
    u32_t t_cyc;
    u32_t t_delta_cyc;  // time since sm reset
};

/// used for logging
struct Wait_Event{
    cycle_state_id_t state;
    u8_t substate;
    u32_t t_wait_cyc;
    sm_wait_reason_t reason;
};

/// used easuring performance of actions
/// (Can use switch events, too.)
struct Perf_Event{
    cycle_state_id_t state;
    u8_t substate;
    u32_t t_actions_cyc;
};


// todo: all threadsafe, repeated call safe?

// control
int state_mng_reset();
void state_mng_configure(struct State cust_states[], cycle_state_id_t * cust_tt, int len_states, int len_events);
void state_mng_init(struct device * dev);
void state_mng_run(void);   
int state_mng_start();
int state_mng_abort();

// config
int state_mng_register_action(cycle_state_id_t state_id, void (*func)(struct ActionArg const *), irqt_val_id_t arr_vals[], int len);
int state_mng_purge_registered_actions(cycle_state_id_t state_id);
int state_mng_purge_registered_actions_all();

int state_mng_add_filter_state(cycle_state_id_t state_id);
int state_mng_purge_filter_state();
int state_mng_pull_perf_action(int res_buff[], int idx_buf, int len); 

int state_purge_switch_events();

// print
void state_mng_print_state_config();
void state_mng_print_transition_table_config();
void state_mng_print_evt_log();

// getters
cycle_state_id_t state_mng_get_current();
u8_t state_mng_get_current_subs();
int state_mng_get_switch_events(struct Switch_Event * buf, int len_buf);
u32_t state_mng_get_time_delta();
int state_mng_get_timing_goal(struct State * state, u8_t substate, int mode);
bool state_mng_is_running();

// helpers
struct State * state_mng_id_2_state(cycle_state_id_t id_name);
void state_mng_wait_fix(struct State * state, u32_t t_fix, sm_wait_reason_t reason);
bool state_mng_wait_vals_ready(struct State * state);


#endif
```

## src/states.c
```c
#ifndef TEST_MINIMAL
#include "states.h"
#include "state_manager.h"
#include "utils.h"

#define SYS_LOG_DOMAIN "States"  
#define SYS_LOG_LEVEL SYS_LOG_LEVEL_DEBUG
#include <logging/sys_log.h>
#include <string.h>

/**
 * Defines a minimal set of states
 * Use state_manager::register_action() to set state actions and required values.
 * CHANGES may make benchmarks based on SM auto uncomparable!
 *-----------------------------------------------------------------------------
 */

static struct State s_idle = {.id_name = CYCLE_STATE_IDLE, .default_next_state = CYCLE_STATE_IDLE,
        .timing_goal_start = 0, .timing_goal_end = 0,  
        };

static struct State s_start = {.id_name = CYCLE_STATE_START, .default_next_state = CYCLE_STATE_END,
        .timing_goal_start = 0, .timing_goal_end = 0,  
        };

static struct State s_end = {.id_name = CYCLE_STATE_END, .default_next_state = CYCLE_STATE_IDLE,
        .timing_goal_start = 0, .timing_goal_end = 0, 
        };

/**
 * @brief: Set up state array and transition table automatically. 
 * 
 * Uses auto SM states hard-coded in states.c.
 * Is used for tests/benchs with a minimal critical loop.
 * Registers a (default) action handler to every state, which is a function
 * that is responsible to fire all registered callbacks. 
 */
void states_configure_auto(struct State * states, cycle_state_id_t * transition_table, void * action){
    // non thread safe, never call if running
    // cast to pointers to array with correct dimensions
    struct State (*states_p)[_NUM_CYCLE_STATES]  = (struct State (*)[_NUM_CYCLE_STATES])states;
    cycle_state_id_t (*tt_p)[_NUM_CYCLE_STATES][_NUM_CYCLE_EVENTS] = (cycle_state_id_t (*)[_NUM_CYCLE_STATES][_NUM_CYCLE_EVENTS]) transition_table;

    // set (usually default) action handler, argument is casted to correct function type 
    s_idle.action =     (void (*)(cycle_state_id_t))action;
    s_start.action =    (void (*)(cycle_state_id_t))action;
    s_end.action =      (void (*)(cycle_state_id_t))action;

    // initialize array for safety
    for(int i=0; i<STATES_REQ_VALS_MAX; i++){
        s_idle.val_ids_req[i] = _NIL_VAL;
        s_start.val_ids_req[i] = _NIL_VAL;
        s_end.val_ids_req[i] = _NIL_VAL;
    }

     // manually set up all states[_NUM_CYCLE_STATES] as defined in enum cycle_state_id_t
    (*states_p)[CYCLE_STATE_IDLE] = s_idle;
    (*states_p)[CYCLE_STATE_START] = s_start;
    (*states_p)[CYCLE_STATE_END] = s_end;

    // manually set up transition table[_NUM_CYCLE_STATES][_NUM_CYCLE_EVENTS]
    // for CYCLE_STATE_IDLE
    cycle_event_id_t t0[_NUM_CYCLE_EVENTS] = \
        {(*states_p)[CYCLE_STATE_IDLE].default_next_state, CYCLE_STATE_START};  
    (*tt_p)[CYCLE_STATE_IDLE][_CYCLE_DEFAULT_EVT] = t0[0];   
    (*tt_p)[CYCLE_STATE_IDLE][CYCLE_EVENT_RESET_IRQ] = t0[1];  
    // for CYCLE_STATE_START    
    cycle_event_id_t t1[_NUM_CYCLE_EVENTS] = \
        {(*states_p)[CYCLE_STATE_START].default_next_state, CYCLE_STATE_START};  
    (*tt_p)[CYCLE_STATE_START][_CYCLE_DEFAULT_EVT] = t1[0];   
    (*tt_p)[CYCLE_STATE_START][CYCLE_EVENT_RESET_IRQ] = t1[1];   
    // for CYCLE_STATE_END        
    cycle_event_id_t t2[_NUM_CYCLE_EVENTS] = \
        {(*states_p)[CYCLE_STATE_END].default_next_state, CYCLE_STATE_START};  
    (*tt_p)[CYCLE_STATE_END][_CYCLE_DEFAULT_EVT] = t2[0];   
    (*tt_p)[CYCLE_STATE_END][CYCLE_EVENT_RESET_IRQ] = t2[1];   

}

/**
 * @brief: Set up state array and transition table of state manager by customnly deployed arrays. 
 * 
 * Registers a default action handler to every state, which is a function
 * that is responsible to fire all registered callbacks. 
 * Non thread safe, never call if sm running
 * 
 * @param states:           Pointer to state_manager state array.
 * @param transition_table: Pointer to state_manager transition_table.
 * @param action:           Function pointer (void-2-void) to default action, usually state manager action dispatcher.
 * @param cust_states[]:    All states to be configured to state machine. Must be static var. todo: really? Copying into sm?
 * @param cust_tt[]:        Transition table to be configure to state machine. Must be static var.
 */
void states_configure_custom(struct State * states, cycle_state_id_t * transition_table, void * action, \
                                struct State cust_states[], cycle_state_id_t * cust_tt, int len_states, int len_events){
    
    // todo: currently, states and trantsition_table configured eg. in sm2.c as static
    // -> waste of memory, but state_manager crashes if declared on stack

    // cast to pointers to array with correct dimensions
    struct State (*states_p)[_NUM_CYCLE_STATES]  = (struct State (*)[_NUM_CYCLE_STATES])states;
    cycle_state_id_t (*tt_p)[_NUM_CYCLE_STATES][_NUM_CYCLE_EVENTS] = (cycle_state_id_t (*)[_NUM_CYCLE_STATES][_NUM_CYCLE_EVENTS]) transition_table;
    cycle_state_id_t (*cust_tt_p)[_NUM_CYCLE_STATES][_NUM_CYCLE_EVENTS] = (cycle_state_id_t (*)[_NUM_CYCLE_STATES][_NUM_CYCLE_EVENTS]) cust_tt;

    if(_NUM_CYCLE_STATES != len_states){
        SYS_LOG_WRN("Provided custom state must be of size _NUM_CYCLE_STATES.");
        return;
    }
    if(_NUM_CYCLE_EVENTS != len_events){
        SYS_LOG_WRN("Provided transition table must have dimension 1 == _NUM_EVENTS_STATES.");
        return;
    }

    // set (usually default) action handler, argument is casted to correct function type 
    for(int i=0; i<len_states; i++)
        cust_states[i].action = (void (*)(cycle_state_id_t))action;

    // copy into state_manger states array
    memcpy(*states_p, cust_states, len_states * sizeof(*states)) ;

    for(int i=0; i<len_states; i++){
        for(int j=0; j<len_events; j++){
            // copy into state_manager transition table
            (*tt_p)[i][j] = (*cust_tt_p)[i][j];
        }
        // set up default (NULL event) transition
        (*tt_p)[i][0] = (*states_p)[i].default_next_state;   // states arr must have been filled before
    }
}

/**
 * @brief: Configure given state with serial substates.
 * todo: make safe while sm running
 * 
 * @param num_substates: number of times the state is repeated
 * @param timing_summand: usually 0
 */
void states_configure_substates(struct State * state, u8_t num_substates, u8_t timing_summand){
    if(num_substates < 1){
        SYS_LOG_WRN("Invalid number of substates %i, set to 1", num_substates);
        num_substates = 1;
    }
    state->max_subs_idx = num_substates - 1;    // idx 0 counts as substate
    state->timing_summand = timing_summand;
}


void states_print_state(struct State * state){
    printk("Printing state struct: \n");
    printk("id: %i \ndefault_next: %i \ngoal_start: %u \ngoal_end: %u \nval_ids_req \n", \
            state->id_name, state->default_next_state,     \
            state->timing_goal_start, state->timing_goal_end);
    print_arr_uint(0, state->val_ids_req, STATES_REQ_VALS_MAX);
    printk("action: %p \n", state->action);

}


int states_get_timing_goal_start(struct State * state, u8_t substate){
    
   
    int result = state->timing_goal_start;   

    // substate logic
    // replicate duration of parent state + summand
    #if(STATES_DIS_SUBSTATES == 0)
    if(likely(state->max_subs_idx > 0))
        result += substate * (state->timing_goal_end - state->timing_goal_start + state->timing_summand);
    #endif

    return result;
}

int states_get_timing_goal_end(struct State * state, u8_t substate){
    
    int result = state->timing_goal_end;

    // substate logic
    // replicate duration of parent state + summand
    #if(STATES_DIS_SUBSTATES == 0)
    if(likely(state->max_subs_idx > 0))
        result += substate * (state->timing_goal_end - state->timing_goal_start + state->timing_summand) ;
    #endif

    return result;
}

int states_set_handler_timing_goal_start(struct State state_arr[], cycle_state_id_t id, void(*handler)(struct State *, int)){
    struct State * state = states_get(state_arr, id);
    if(state->handle_t_goal_start != NULL)
        SYS_LOG_WRN("Overwriting timing goal start handler for state %i", id);
    state->handle_t_goal_start = handler;

    return 0;
}

int states_set_handler_timing_goal_end(struct State state_arr[], cycle_state_id_t id, void(*handler)(struct State *, int)){
    struct State * state = states_get(state_arr, id);
    if(state->handle_t_goal_end != NULL)
        SYS_LOG_WRN("Overwriting timing goal end handler for state %i", id);
    state->handle_t_goal_end = handler;

    return 0;
}

int states_set_handler_reqval(struct State state_arr[], cycle_state_id_t id, bool(*handler)(struct State *)){
    struct State * state = states_get(state_arr, id);
    if(state->handle_val_rfail != NULL)
        SYS_LOG_WRN("Overwriting failed requested value handler for state %i", id);
    state->handle_val_rfail = handler;

    return 0;
}

struct State * states_get(struct State state_arr[], cycle_state_id_t id){
    return &(state_arr[id]);
}

#endif
```

## src/states.h
```c
/**
 * @file
 * @brief define state machine 'state' struct and configure to state_manager
 */


#ifndef STATES_H
#define STATES_H

#include <zephyr.h>
#include "irqtestperipheral.h"

#define STATES_REQ_VALS_MAX         5    // might need adjustment if many vals
#define STATES_CBS_PER_ACTION_MAX   5
//#define STATES_SUBSTATE_SER_DEPTH   3   
#define STATES_DIS_SUBSTATES 0      // 1 to deactivate substates  

/// declares all possible states (.id_names) of a state manager
typedef enum{
    _NIL_CYCLE_STATE,   // must be first
    CYCLE_STATE_IDLE,
    CYCLE_STATE_START, // aka preamble detect
    CYCLE_STATE_DL_CONFIG,
    CYCLE_STATE_DL,
    CYCLE_STATE_UL_CONFIG,
    CYCLE_STATE_UL,
    CYCLE_STATE_RL_CONFIG,
    CYCLE_STATE_RL,
    CYCLE_STATE_END,
    _NUM_CYCLE_STATES // must be last

}cycle_state_id_t;

/// declares all possible events (state_manager.c::SMEvent) causing transitions
typedef enum{
    _CYCLE_DEFAULT_EVT, // must be first -> call next state as define by element 0 of transition table
    CYCLE_EVENT_RESET_IRQ,
    _NUM_CYCLE_EVENTS // must be last

}cycle_event_id_t;


struct State{
    cycle_state_id_t id_name;
    cycle_state_id_t default_next_state;
    u32_t timing_goal_start; // in cpu cycles
    u32_t timing_goal_end;
    irqt_val_id_t val_ids_req[STATES_REQ_VALS_MAX];  // holds the irqt vals requested by state
    void (*action)(cycle_state_id_t);  // method called when switched to this state , note that usually _default_action()
    void (*handle_t_goal_start)(struct State *, int);  // method called when entering state, to act when time goal hit / missed    
    void (*handle_t_goal_end)(struct State *, int);    // method called when leaving state, to act when time goal hit / missed
    bool (*handle_val_rfail)(struct State *);    // called when check_vals_ready fails at beginning of state, returns true if actions should be skipped

    // serial substates logic: automatically invoked as next state
    // until all substates have occured (eg. for multiple user time slots)
    // they "inherit" all states var but modify timing goals
    // affects state_manager::switch_state() and ::check_time_goal()
    u8_t cur_subs_idx;
    u8_t max_subs_idx;
    u32_t timing_summand;  // added to timing_goals additionaly to duration of state
};

/// struct passed to any registered action as argument
struct ActionArg{
    struct State * state_cur;
};



void states_configure_auto(struct State * states, cycle_state_id_t * transition_table, void * action);
void states_configure_custom(struct State * states, cycle_state_id_t * transition_table, void * action, \
                                struct State cust_states[], cycle_state_id_t * cust_tt, int len_states, int len_events);
void states_configure_substates(struct State * state, u8_t num_substates, u8_t timing_summand);

struct State * states_get(struct State state_arr[], cycle_state_id_t id);
int states_get_timing_goal_start(struct State * state, u8_t substate);
int states_get_timing_goal_end(struct State * state, u8_t substate);

int states_set_handler_timing_goal_start(struct State state_arr[], cycle_state_id_t id, void(*handler)(struct State *, int));
int states_set_handler_timing_goal_end(struct State state_arr[], cycle_state_id_t id, void(*handler)(struct State *, int));
int states_set_handler_reqval(struct State state_arr[], cycle_state_id_t id, bool(*handler)(struct State *));
 

void states_print_state(struct State * state);

#endif
```

## src/utils.c
```c
/* utils.c - modified utility functions, originially used by tests/benchmark/latency measurement */

/*
 * Copyright (c) 2012-2014 Wind River Systems, Inc.
 *
 * SPDX-License-Identifier: Apache-2.0
 */

/*
 * DESCRIPTION
 * this file contains commonly used functions
 */


#include <zephyr.h>
#include "utils.h"

#ifndef TEST_MINIMAL

#ifdef CONFIG_PRINTK
#include <misc/printk.h>
#include <stdio.h>
#include <string.h>
#else
#warning PRINTK configuration option needs to be enabled
#endif


static int verbosity_thresh = -1;


void print_set_verbosity(int verb){
    if(verb > 1)
        printk("INFO: Set printkv verbosity to %i \n", verb);
    verbosity_thresh = verb;
}

int print_get_verbosity(){
    return verbosity_thresh;
}

static bool do_print(int verbosity, bool exact){
    bool cond1 = (verbosity_thresh >= verbosity);
    if(exact)
        cond1 = (verbosity_thresh == verbosity);

    return (cond1 || verbosity == 0 || verbosity_thresh < 0);
}

/**
 * @brief: printk if given verbosity >= set verbosity threshold. 
 * 
 * @param verbosity: print always if 0
 */

void printkv(int verbosity, const char *fmt, ...){

    // predict branch assuming verbosity is not high
    if(unlikely(do_print(verbosity, false))){
        va_list args;
        va_start(args, fmt);

        vprintk(fmt, args); 
        va_end(args);
    }
}
/**
 * @brief: printk if given verbosity exactly == set verbosity threshold. 
 * 
 * @param verbosity: print always if 0
 */

void printkve(int verbosity, const char *fmt, ...){

    if(unlikely(do_print(verbosity, true))){
        va_list args;
        va_start(args, fmt);

        vprintk(fmt, args); 
        va_end(args);
    }
}


/**
 * @brief Print dash line
 *
 * @return N/A
 */
void print_dash_line(int verbosity){
	printkv(verbosity, "|-------------------------------------------------------"
	       "----------------------|\n");
}

void print_report(int verbosity, int err_count){
	print_dash_line(verbosity);
    if(err_count == 0){
        printk_framed(verbosity, "All tests PASSED");
    }
    else{
        printk_framed(verbosity, "Tests FAILED with %i errors", err_count);
    }
    print_dash_line(verbosity);

}

void print_end_banner(int verbosity)	{								
	printkv(verbosity, "|                                    E N D             " \
	       "                       |\n");				\
	print_dash_line(verbosity);						\
} 


void print_banner(int verbosity)	 {								
	print_dash_line(verbosity);						\
	printkv(verbosity, "|                            Latency Benchmark         " \
	       "                       |\n");				\
	print_dash_line(verbosity);						\
} 


void print_time_banner(int verbosity){								
	printk_framed(verbosity, "tcs = timer clock cycles: 1 tcs is %u nsec",	
		     SYS_CLOCK_HW_CYCLES_TO_NS(1));			
	print_dash_line(verbosity);						
} 



/**
 * @brief prints string in the center of console
 * 
 * Automatically adds \n identifier for end of line.
 * Uses standard width value of 80 for console.
 */
void printk_centered(int verbosity, const char *fmt, ...){
    va_list args;
	va_start(args, fmt);

    if(!do_print(verbosity, false))
        return;

	

    size_t str_length = vsnprintk(NULL, 0, fmt, args);
	int width = 80-1;

    // if a new length is less or equal length of the original string, returns the original string
    if (width <= str_length){
        vprintk(fmt, args);
		return;
	}

    unsigned int i, total_rest_length;

    // length of a wrapper of the original string
    total_rest_length = width - str_length;

    // write a prefix
    i = 0;
    while (i < (total_rest_length / 2)) {
        printk(" ");
        ++i;
    }
 
	vprintk(fmt, args);
	 
    va_end(args);

}

/**
 * @brief 	prints string in the center of console with | at beginning
 * 			and end of line. 
 * 
 * Automatically adds \n identifier for end of line.
 * Uses standard width value of 80 for console.
 */
void printk_framed(int verbosity, const char *fmt, ...){

    va_list args;
	va_start(args, fmt);

    if(!do_print(verbosity, false)){
        return;
    }

	size_t str_length = vsnprintk(NULL, 0, fmt, args);
	//printk("DEBUG: Length of string %i \n", str_length);
	int width = 80-1;
	width -= 2; // for framing

    // if a new length is less or equal length of the original string, returns the original string
    if (width <= str_length){
        vprintk(fmt, args);
		return;
	}

    unsigned int i, total_rest_length;

    // length of a wrapper of the original string
    total_rest_length = width - str_length;

    // write a prefix 
    i = 0;
	printk("|");
    while (i < (total_rest_length / 2)) {
        printk(" ");
        ++i;
    }
 
    // write the original string
    //printk("%s", string);
    vprintk(fmt, args);
	  
    va_end(args);

    // write a postfix 
    i += str_length;
    while (i < width) {
        printk(" ");
        ++i;
    }
	printk("|\n");
}


void print_arr_int(int verbosity, int arr[], int len){
    int i;
    for (i=0; i < len; i++) {
        if(i == len-1)
            printkv(verbosity, "%i", (int)arr[i]);
        else
            printkv(verbosity, "%i, ", (int)arr[i]);
    }
    printkv(verbosity, "\n");
}

void snprint_arr_int(char * str, int len_str, int arr[], int len){
    // credits
    // https://stackoverflow.com/questions/30234363/how-can-i-store-an-int-array-into-string
    int i;
    int i_str = 0;
    int add_i_str = 0;

    for (i=0; i < len; i++) {
        add_i_str = 0;
        if(i == len-1)
            add_i_str = snprintk(str+i_str, len_str-i_str, "%i",  (int)arr[i]);
        else
            add_i_str = snprintk(str+i_str, len_str-i_str, "%i, ", (int)arr[i]);
        // buffer full
        if(add_i_str < 0)
            break;
        i_str += add_i_str;      
    }
  
}

void snprint_arr_p(char * str, int len_str, void * arr[], int len){
    // credits
    // https://stackoverflow.com/questions/30234363/how-can-i-store-an-int-array-into-string
    int i;
    int i_str = 0;
    int add_i_str = 0;

    for (i=0; i < len; i++) {
        add_i_str = 0;
        if(i == len-1)
            add_i_str = snprintk(str+i_str, len_str-i_str, "%p",  (void*)arr[i]);
        else
            add_i_str = snprintk(str+i_str, len_str-i_str, "%p, ", (void*)arr[i]);
        // buffer full
        if(add_i_str < 0)
            break;
        i_str += add_i_str;
        
    }
}

void print_arr_uint(int verbosity, u32_t arr[], int len){
    int i;
    for (i=0; i < len; i++) {
        if(i == len-1)
            printkv(verbosity, "%u", (int)arr[i]);
        else
            printkv(verbosity, "%u, ", (int)arr[i]);
    }
    printkv(verbosity, "\n");
}


u32_t dbg_read_mem(u32_t * p_mem){
	u32_t reg;
	// write pointer p_mem to a5
	__asm__ volatile("mv a5, %0" :: "r" (p_mem));
	// load mem at p_mem to a4
	__asm__ volatile("lw a4, 0(a5)");
	// read a4
	__asm__ volatile("addi %0, a4, 0" : "=r" (reg));
	
	return reg;

}


#endif // TEST_MINIMAL
```
